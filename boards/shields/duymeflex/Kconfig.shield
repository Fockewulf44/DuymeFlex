## boards/shields/duymeflex/Kconfig.shield
```kconfig
config SHIELD_DUYMEFLEX_LEFT
    def_bool $(shields_list_contains,duymeflex_left)
  
config SHIELD_DUYMEFLEX_RIGHT
    def_bool $(shields_list_contains,duymeflex_right)
  
```
