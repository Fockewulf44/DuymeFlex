#include "duymeflex.dtsi"

/ {
    kscan0: kscan0 {
        compatible = "zmk,kscan-gpio-matrix";
        diode-direction = "col2row";
        wakeup-source;

        col-gpios
            = 
            ;

        row-gpios
            = 
            ;
    };
};

&matrix_transform0 {
    col-offset = <6>;
};

&physical_layout_duymeflex {
    kscan = <&kscan0>;
};

